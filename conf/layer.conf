## conf/layer.conf
```bitbake
BBPATH .= ":${LAYERDIR}"
BBFILES += "${LAYERDIR}/recipes-*/*/*.bb ${LAYERDIR}/recipes-*/*/*.bbappend"
BBFILE_COLLECTIONS += "hoki-ex"
BBFILE_PATTERN_hoki-ex = "^${LAYERDIR}/"
BBFILE_PRIORITY_hoki-ex = "19"
LAYERSERIES_COMPAT_hoki-ex = "whinlatter"
LAYERDEPENDS_hoki-ex = "core asteroid-layer hoki-hybris-layer"
```
